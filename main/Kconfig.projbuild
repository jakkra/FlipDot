## main/Kconfig.projbuild
```kconfig
menu "FlipDot Configuration"
    choice WIFI_MODE
        bool "WiFi Mode"
        default WIFI_MODE_STATION
    
    config WIFI_MODE_STATION
        bool "Station"
    
    config WIFI_MODE_AP
        bool "AP"
    
    endchoice
    config WIFI_SSID
        string "WiFi SSID"
        default "myssid"
        help
            SSID (network name) for the display to connect to.

    config WIFI_PASSWORD
        string "WiFi Password"
        default "mypassword"
        help
            WiFi password (WPA or WPA2) for the display to use when connecting.

    config HOME_ASSISTANT_BEARER_TOKEN
        string "Home assistant Bearer token"
        default ""
    
    config HOME_ASSISTANT_IP_ADDR
        string "Home assistant IP"
        default "192.168.1.65:8123"
        
    config HOME_ASSISTANT_SENSOR_ENTITY_ID
        string "Home assistant temperature sensor entity id to fetch the temperature from"
        default "sensor.ble_temperature_mi_temp_2"

    config HOME_ASSISTANT_SENSOR_TEMP_OUTSIDE_ENTITY_ID
        string "Home assistant outside temperature sensor entity id to fetch the temperature from"
        default "sensor.ble_temperature_mi_temp_1"
        
    config HOME_ASSISTANT_SENSOR_ENTITY_SOLAR_PRODUCTION_ID
        string "Home assistant current solar power photovoltaics sensor entity id."
        default "sensor.solarnet_power_photovoltaics"

    config RS485_UART_PORT_NUM
        int "UART port number"
        range 0 2
        default 2
        help
            UART communication port number.    
    config RS485_UART_BAUD_RATE
        int "UART communication speed"
        range 1200 115200
        default 57600
        help
            UART communication speed for Modbus.

    config RS485_UART_RXD
        int "UART RXD pin number"
        default 22
        help
            GPIO number for UART RX pin.

    config RS485_UART_TXD
        int "UART TXD pin number"
        range 0 34
        default 23

    config RS485_UART_RTS
        int "UART RTS pin number"
        default 18
        help
            GPIO number for UART RTS pin. This pin is connected to
            ~RE/DE pin of RS485 transceiver to switch direction.

    config FLIP_DOT_DEBUG_UART_OUTPUT
        bool "Mirror display data to the log for debugging"
        default n
        help
            When enabled, every frame sent to the flip-dot display is additionally
            written to the ESP32 log so it can be consumed by a host-side viewer.

    endmenu
```

## sdkconfig.defaults
```kconfig
#
# FlipDot Configuration
#
CONFIG_WIFI_MODE_STATION=y
# CONFIG_WIFI_MODE_AP is not set
CONFIG_WIFI_SSID="myssid"
CONFIG_WIFI_PASSWORD="mypassword"

CONFIG_HTTPD_WS_SUPPORT=y
CONFIG_HOME_ASSISTANT_SENSOR_ENTITY_ID="sensor.ble_temperature_mi_temp_2"
CONFIG_HOME_ASSISTANT_SENSOR_TEMP_OUTSIDE_ENTITY_ID="sensor.ble_temperature_mi_temp_1"
CONFIG_HOME_ASSISTANT_SENSOR_ENTITY_SOLAR_PRODUCTION_ID="sensor.solarnet_power_photovoltaics"
CONFIG_HOME_ASSISTANT_IP_ADDR="192.168.1.65:8123"
CONFIG_HOME_ASSISTANT_BEARER_TOKEN="Bearer long_lived_token"

CONFIG_LWIP_MAX_SOCKETS=16
CONFIG_LWIP_SO_REUSE=y
CONFIG_LWIP_SO_LINGER=y
CONFIG_LWIP_TCP_MSS=1436
CONFIG_LWIP_TCP_RECVMBOX_SIZE=12
CONFIG_LWIP_UDP_RECVMBOX_SIZE=12
CONFIG_LWIP_TCP_TMR_INTERVAL=250
CONFIG_LWIP_TCP_FIN_WAIT_TIMEOUT=5000
CONFIG_LWIP_TCP_MAXRTX=6
CONFIG_HTTPD_MAX_OPEN_SOCKETS=8

# Aggressive TCP timeout settings to close sockets faster
CONFIG_LWIP_TCP_KEEPALIVE_DEFAULT=y
CONFIG_LWIP_TCP_KEEPIDLE_DEFAULT=7200
CONFIG_LWIP_TCP_KEEPINTVL_DEFAULT=75
CONFIG_LWIP_TCP_KEEPCNT_DEFAULT=9
CONFIG_LWIP_TCP_SND_TIMEOUT=20000
CONFIG_LWIP_TCP_CLOSE_TIMEOUT=20000
CONFIG_LWIP_TCP_SYNMAXRTX=6
CONFIG_LWIP_TCP_OOSEQ_TIMEOUT=6000
CONFIG_LWIP_TCPIP_RECVMBOX_SIZE=8

# HTTP server timeout settings
CONFIG_HTTPD_RECV_WAIT_TIMEOUT=5
CONFIG_HTTPD_SEND_WAIT_TIMEOUT=5

# Additional socket cleanup settings
CONFIG_LWIP_SO_RCVBUF=y
CONFIG_LWIP_TCP_RECVMBOX_SIZE=6
CONFIG_LWIP_UDP_RECVMBOX_SIZE=6

# Partition Table Configuration
# Use large single app partition to accommodate larger binary
# CONFIG_PARTITION_TABLE_SINGLE_APP is not set
# CONFIG_PARTITION_TABLE_SINGLE_APP_LARGE=y
# CONFIG_PARTITION_TABLE_TWO_OTA is not set
# CONFIG_PARTITION_TABLE_TWO_OTA_LARGE is not set
# CONFIG_PARTITION_TABLE_CUSTOM is not set

CONFIG_FLIP_DOT_DEBUG_UART_OUTPUT=n

CONFIG_ESPTOOLPY_FLASHSIZE_4MB=y
CONFIG_PARTITION_TABLE_TWO_OTA_LARGE=y
CONFIG_ESP_HTTPS_OTA_ALLOW_HTTP=y
```
